;
; BIOS definitions
;

PSLTRG			= $A8			; I/O port address of primary slot register

WBOOT			= $00
RDSLT			= $0C
WRSLT			= $14
CALSTL			= $1C
ENASLT			= $24
IDBYT0			= $2B
BASVER			= $2D
CALLF			= $30
KEYINT			= $38
WRTVDP			= $47
LDIRMV			= $59
LDIRVM			= $5C
CHGMOD			= $5F
INITXT			= $6C
CHSNS			= $9C
CHGET			= $9F
CHPUT			= $A2
LPTOUT			= $A5
BREAKX			= $B7
CKCNTC			= $BD
ERAFNK			= $CC
TOTEXT			= $D2
SNSMAT			= $141
PHYDIO			= $144
KILBUF			= $156
CALBAS			= $159
EXTROM			= $15F

RDPRIM			= $F380
WRPRIM			= $F385
CLPRIM			= $F38C
CLPRM1			= $F398
LINL40			= $F3AE
LINLEN			= $F3B0
CNSDFG			= $F3DE
LPTPOS			= $F415
PRTFLG			= $F416
CURLIN			= $F41C
KBUF			= $F41F
BUF				= $F55E
TTYPOS			= $F661
VALTYP			= $F663
MEMSIZ			= $F672
STKTOP			= $F674
TXTTAB			= $F676
TEMPPT			= $F678
TEMPST			= $F67A
DSCTMP			= $F698
FRETOP			= $F69B
AUTLIN			= $F6AB
SAVSTK			= $F6B1
VARTAB			= $F6C2
STREND			= $F6C6
DAC				= $F7F6
ARG				= $F847
MAXFIL			= $F85F
FILTAB			= $F860
NULBUF			= $F862
PTRFIL			= $F864
FILNAM			= $F866
NLONLY			= $F87C
SAVEND			= $F87D
EXBRSA			= $FAF0
HOKVLD			= $FB20
YFB21			= $FB21					; diskdriver table
YFB29			= $FB29					; diskdriver interrupt table
BOTTOM			= $FC48
HIMEM			= $FC4A
CSRSW			= $FCA9
FLBMEM			= $FCAE
RUNBNF			= $FCBE
SAVENT			= $FCBF
EXPTBL			= $FCC1					; slots expanded or not
SLTTBL			= $FCC5
SLTATR			= $FCC9
SLTWRK			= $FD09
PROCNM			= $FD89
DEVICE			= $FD99
H.TIMI			= $FD9F
H.KEYI			= $FD9A					; interrupt hook
H.DSKO			= $FDEF
H.NAME			= $FDF9
H.KILL			= $FDFE
H.COPY			= $FE08
H.DSKF			= $FE12
H.DSKI			= $FE17
H.LSET			= $FE21
H.RSET			= $FE26
H.FIEL			= $FE2B
H.MKI			= $FE30
H.MKS			= $FE35
H.MKD			= $FE3A
H.CVI			= $FE3F
H.CVS			= $FE44
H.CVD			= $FE49
H.GETP			= $FE4E
H.NOFO			= $FE58
H.NULO			= $FE5D
H.NTFL			= $FE62
H.BINS			= $FE71
H.BINL			= $FE76
H.FILE			= $FE7B
H.DGET			= $FE80
H.FILO			= $FE85
H.INDS			= $FE8A
H.LOC			= $FE99
H.LOF			= $FE9E
H.EOF			= $FEA3
H.BAKU			= $FEAD
H.PARD			= $FEB2
H.NODE			= $FEB7
H.POSD			= $FEBC
H.RUNC			= $FECB
H.CLEA			= $FED0
H.LOPD			= $FED5
H.STKE			= $FEDA
H.ERRP			= $FEFD
H.PHYD			= $FFA7
H.FORM			= $FFAC
EXTBIO			= $FFCA
DISINT			= $FFCF
ENAINT			= $FFD4
EXTVDP			= $FFE7
